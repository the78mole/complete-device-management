## device-stack/yocto-raspberrypi4-tpm/conf/bblayers.conf
```bitbake
# bblayers.conf – CDM Yocto TPM layer configuration
#
# Adds meta-security on top of the standard RPi 4 layer set.
# meta-cdm-tpm is appended by docker-entrypoint.sh from /workspace/meta-cdm-tpm.

BBLAYERS_CONF_VERSION = "2"

BBPATH  = "${TOPDIR}"
BBFILES = ""

BBLAYERS ?= " \
  /yocto/layers/poky/meta \
  /yocto/layers/poky/meta-poky \
  /yocto/layers/poky/meta-yocto-bsp \
  /yocto/layers/meta-openembedded/meta-oe \
  /yocto/layers/meta-openembedded/meta-multimedia \
  /yocto/layers/meta-openembedded/meta-networking \
  /yocto/layers/meta-openembedded/meta-python \
  /yocto/layers/meta-openembedded/meta-perl \
  /yocto/layers/meta-raspberrypi \
  /yocto/layers/meta-security \
  /yocto/layers/meta-security/meta-tpm \
  "
```

## device-stack/yocto-raspberrypi4-tpm/conf/local.conf
```bitbake
# local.conf – CDM Yocto TPM build config for Raspberry Pi 4 (64-bit)

MACHINE = "raspberrypi4-64"

IMAGE_FSTYPES = "wic.bz2 wic.bmap"

# ── TPM SPI device tree overlay ───────────────────────────────────────────────
# Activates the SLB967x TPM on SPI0 CE1 (pin 26).
# The tpm-slb9670 overlay covers the full SLB967x family including SLB9672.
# SPI0_CE1 = GPIO7: change to ce0 (GPIO8, pin 24) if wiring uses CE0.
ENABLE_UART = "1"
RPI_EXTRA_CONFIG = '\
# CDM TPM: Infineon SLB9672 on SPI0 CE1\n\
dtoverlay=tpm-slb9670,ce1_pin=26\n\
'

# ── Package manager ───────────────────────────────────────────────────────────
PACKAGE_CLASSES = "package_ipk"

# ── Packages ──────────────────────────────────────────────────────────────────
# tpm2-tools   – tpm2_createprimary, tpm2_create, tpm2_evictcontrol, …
# tpm2-tss     – TCG TSS2 stack (tcsd / tss2 libraries)
# tpm2-abrmd   – Access Broker & Resource Manager daemon (tpm2-abrmd)
# tpm2-openssl – OpenSSL 3.x provider: allows `openssl … -provider tpm2`
# tpm2-pkcs11  – PKCS#11 backend for tpm2-tss (for mosquitto/libp11 path)
IMAGE_INSTALL:append = " \
    openssl \
    openssl-bin \
    curl \
    mosquitto-clients \
    bash \
    coreutils \
    tpm2-tools \
    tpm2-tss \
    tpm2-abrmd \
    tpm2-openssl \
    tpm2-pkcs11 \
    pkcs11-helper \
    libp11 \
    cdm-enroll-tpm \
"

BB_NUMBER_THREADS ?= "${@min(os.cpu_count(), 8)}"
PARALLEL_MAKE     ?= "-j ${@min(os.cpu_count(), 8)}"

LICENSE_FLAGS_ACCEPTED = "synaptics-killswitch commercial"
EXTRA_IMAGE_FEATURES += "ssh-server-openssh"
EXTRA_IMAGE_FEATURES += "debug-tweaks"

# Kernel config fragment for TPM SPI driver (applied by bbappend in meta-cdm-tpm)
KERNEL_FEATURES:append = " cfg/tpm-spi.scc"
```

## device-stack/yocto-raspberrypi4-tpm/meta-cdm-tpm/conf/layer.conf
```bitbake
# meta-cdm-tpm/conf/layer.conf

BBPATH    .= ":${LAYERDIR}"
BBFILES   += "${LAYERDIR}/recipes-*/*/*.bb ${LAYERDIR}/recipes-*/*/*.bbappend"

BBFILE_COLLECTIONS  += "meta-cdm-tpm"
BBFILE_PATTERN_meta-cdm-tpm = "^${LAYERDIR}/"
BBFILE_PRIORITY_meta-cdm-tpm = "11"

LAYERDEPENDS_meta-cdm-tpm = "core raspberrypi security tpm"
LAYERSERIES_COMPAT_meta-cdm-tpm = "scarthgap"
```

## device-stack/yocto-raspberrypi4/conf/bblayers.conf
```bitbake
# bblayers.conf – CDM Yocto layer configuration
#
# Absolute paths point to the layers cloned into the Docker image at /yocto/layers/.
# meta-cdm is appended by docker-entrypoint.sh from /workspace/meta-cdm.

BBLAYERS_CONF_VERSION = "2"

BBPATH  = "${TOPDIR}"
BBFILES = ""

BBLAYERS ?= " \
  /yocto/layers/poky/meta \
  /yocto/layers/poky/meta-poky \
  /yocto/layers/poky/meta-yocto-bsp \
  /yocto/layers/meta-openembedded/meta-oe \
  /yocto/layers/meta-openembedded/meta-multimedia \
  /yocto/layers/meta-openembedded/meta-networking \
  /yocto/layers/meta-openembedded/meta-python \
  /yocto/layers/meta-raspberrypi \
  "
```

## device-stack/yocto-raspberrypi4/conf/local.conf
```bitbake
# local.conf – CDM Yocto build configuration for Raspberry Pi 4 (64-bit)
#
# This file is copied into $BUILD_DIR/conf/local.conf by docker-entrypoint.sh.
# DL_DIR and SSTATE_DIR are injected at runtime from the mounted volumes.

# ── Target machine ────────────────────────────────────────────────────────────
MACHINE = "raspberrypi4-64"

# ── Image format: WIC (partitioned SD-card image) ─────────────────────────────
IMAGE_FSTYPES = "wic.bz2 wic.bmap"

# Enable UART; allows serial console on RPi 4 GPIO pins
ENABLE_UART = "1"

# ── Package manager ───────────────────────────────────────────────────────────
PACKAGE_CLASSES = "package_ipk"

# ── Extra packages installed into the image ───────────────────────────────────
# Required for CDM enrollment and mTLS MQTT test
IMAGE_INSTALL:append = " \
    openssl \
    openssl-bin \
    curl \
    mosquitto-clients \
    bash \
    coreutils \
    cdm-enroll \
"

# ── Parallel build tuning ─────────────────────────────────────────────────────
BB_NUMBER_THREADS ?= "${@min(os.cpu_count(), 8)}"
PARALLEL_MAKE     ?= "-j ${@min(os.cpu_count(), 8)}"

# ── Misc ──────────────────────────────────────────────────────────────────────
# Accept commercial licenses (required for some RPi firmware blobs)
LICENSE_FLAGS_ACCEPTED = "synaptics-killswitch commercial"

# SSH server for remote access during development
EXTRA_IMAGE_FEATURES += "ssh-server-openssh"

# Useful debug tools (remove for production)
EXTRA_IMAGE_FEATURES += "debug-tweaks"
```

## device-stack/yocto-raspberrypi4/meta-cdm/conf/layer.conf
```bitbake
# meta-cdm/conf/layer.conf
# CDM custom Yocto layer – provides cdm-enroll recipe and cdm-image-rpi4 image.

BBPATH    .= ":${LAYERDIR}"
BBFILES   += "${LAYERDIR}/recipes-*/*/*.bb ${LAYERDIR}/recipes-*/*/*.bbappend"

BBFILE_COLLECTIONS  += "meta-cdm"
BBFILE_PATTERN_meta-cdm = "^${LAYERDIR}/"
BBFILE_PRIORITY_meta-cdm = "10"

LAYERDEPENDS_meta-cdm = "core raspberrypi"
LAYERSERIES_COMPAT_meta-cdm = "scarthgap"
```
